## main/Kconfig.projbuild
```kconfig
menu "Device Configuration"

    config TIMEZONE
        string "Device timezone"
        default "IRST-3:30"
        help
            POSIX timezone used when displaying synchronized time.

    config WIFI_DEFAULT_SSID
        string "Default AP SSID"
        default "ESP32-S3-AP"
        help
            Wi-Fi SSID used when no value is stored in NVS.

    config WIFI_DEFAULT_PASSWORD
        string "Default AP password"
        default "12345678"
        help
            Wi-Fi password used when no value is stored in NVS.

    config WIFI_DEFAULT_CHANNEL
        int "Default AP channel"
        range 1 13
        default 1

    config WIFI_DEFAULT_MAX_CONNECTIONS
        int "Default max AP connections"
        range 1 8
        default 4

    config WIFI_DEFAULT_IP
        string "Default AP IP address"
        default "192.168.4.1"

    config WIFI_DEFAULT_GATEWAY
        string "Default AP gateway"
        default "192.168.4.1"

    config HTTP_SERVER_PORT
        int "Default HTTP server port"
        range 1 65535
        default 80

endmenu

menu "Wi-Fi Station Configuration"

    config WIFI_REMOTE_SSID
        string "Remote AP SSID"
        default "my-router"
        help
            SSID of the Wi-Fi network the device should join as a station.

    config WIFI_REMOTE_PASSWORD
        string "Remote AP password"
        default "password"
        help
            Password of the Wi-Fi network the device should join as a station.

    config WIFI_STA_MAX_RETRY
        int "Maximum station retry count"
        range 0 255
        default 5

    config WIFI_NTP_SERVER_1
        string "NTP server 1"
        default "ir.pool.ntp.org"

    config WIFI_NTP_SERVER_2
        string "NTP server 2"
        default "time.google.com"

    config WIFI_NTP_SERVER_3
        string "NTP server 3"
        default "time.cloudflare.com"

endmenu
```

## sdkconfig.defaults
```kconfig
CONFIG_PARTITION_TABLE_CUSTOM=y
CONFIG_PARTITION_TABLE_CUSTOM_FILENAME="partitions.csv"
CONFIG_ESPTOOLPY_FLASHSIZE_8MB=y
CONFIG_SPIRAM=y
CONFIG_FREERTOS_USE_TRACE_FACILITY=y
CONFIG_FREERTOS_GENERATE_RUN_TIME_STATS=y
CONFIG_BOOTLOADER_APP_ROLLBACK_ENABLE=y
CONFIG_LWIP_IP_FORWARD=y
CONFIG_LWIP_IPV4_NAPT=y
CONFIG_LWIP_SNTP_MAX_SERVERS=3
CONFIG_TIMEZONE="IRST-3:30"
CONFIG_WIFI_NTP_SERVER_1="ir.pool.ntp.org"
CONFIG_WIFI_NTP_SERVER_2="time.google.com"
CONFIG_WIFI_NTP_SERVER_3="time.cloudflare.com"
```
